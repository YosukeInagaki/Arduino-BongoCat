// Use Adafruit's GFX and SSD1306 (display driver) library
#include <Wire.h>
#include <Adafruit_GFX.h>
#include <Adafruit_SSD1306.h>

#define SCREEN_WIDTH 128 // OLED display width, in pixels
#define SCREEN_HEIGHT 64 // OLED display height, in pixels

// Declaration for an SSD1306 display connected to I2C (SDA, SCL pins)
#define OLED_RESET     4 // Reset pin # (or -1 if sharing Arduino reset pin)
Adafruit_SSD1306 display(SCREEN_WIDTH, SCREEN_HEIGHT, &Wire, OLED_RESET);

boolean ledState = LOW;
unsigned long ledPreviousMillis = 0;
const long ledInterval = 1000;

boolean bongoState = false;
unsigned long bongoPreviousMillis = 0;
const long bongoInterval = 100; 

#define BONGO_HEIGHT   64
#define BONGO_WIDTH    64

// 'bongoup' and 'bongodown', 128x64px
const unsigned char bongodown [] PROGMEM =
{ B00000000,B00000000,B00000000,B00000000,B00000000,B00000000,B00000000,B00000000,
  B00000000,B00000000,B00000000,B00000000,B00000000,B00000000,B00000000,B00000000,
  B00000000,B00000000,B00000000,B00000000,B00000000,B00000000,B00000000,B00000000,
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  B00000000,B00000000,B00000000,B00000000,B00000000,B00000000,B00000000,B00000000 };
  
const unsigned char bongoup [] PROGMEM =
{ B00000000,B00000000,B00000000,B00000000,B00000000,B00000000,B00000000,B00000000,
  B00000000,B00000000,B00000000,B00000000,B00000000,B00000000,B00000000,B00000000,
  B00000000,B00000000,B00000000,B00000000,B00000000,B00000000,B00000000,B00000000,
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  B00000000,B00000000,B00000000,B00000000,B00000000,B00000000,B00000000,B00000000 };
void setup()
{
  pinMode(LED_BUILTIN, OUTPUT);
  
  Serial.begin(9600);
  // SSD1306_SWITCHCAPVCC = generate display voltage from 3.3V internally
  if(!display.begin(SSD1306_SWITCHCAPVCC, 0x3C))
  {
    Serial.println(F("SSD1306 allocation failed"));
    for(;;);
  }
  
  display.clearDisplay();
  display.invertDisplay(true);
}

void loop()
{
  updateLED();
  updateBongo();
  delay(20);
}

void updateBongo()
{
  unsigned long currentMillis = millis();
  if (currentMillis - bongoPreviousMillis >= bongoInterval)
  {
    bongoPreviousMillis = currentMillis;
    bongoState = !bongoState;
    if (bongoState == true)
    {
      display.clearDisplay();
      display.drawBitmap(
      (display.width()  - BONGO_WIDTH ) / 2,
      (display.height() - BONGO_HEIGHT) / 2,
      bongodown, BONGO_WIDTH, BONGO_HEIGHT, 1);
      display.display();
    }
    else
    {
      display.clearDisplay();
      display.drawBitmap(
      (display.width()  - BONGO_WIDTH ) / 2,
      (display.height() - BONGO_HEIGHT) / 2,
      bongoup, BONGO_WIDTH, BONGO_HEIGHT, 1);
      display.display();
    }
  }
}

void updateLED()
{
  unsigned long currentMillis = millis();
  if(currentMillis - ledPreviousMillis >= ledInterval)
  {
    ledPreviousMillis = currentMillis;
    ledState = !ledState;
    digitalWrite(LED_BUILTIN, ledState);
  }
}
